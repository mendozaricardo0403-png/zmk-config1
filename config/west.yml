## config/west.yml
```yaml
manifest:
  remotes:
    - name: zmkfirmware
      url-base: https://github.com/zmkfirmware
    - name: cannonkeys
      url-base: https://github.com/cannonkeys
  projects:
    - name: zmk
      remote: zmkfirmware
      revision: main
      import: app/west.yml
    - name: zmk-cannonkeys-keyboards
      remote: cannonkeys
      revision: main
  self:
    path: config
```
